## tests/drivers/disk/disk_access/testcase.yaml
```yaml
common:
  harness: ztest
  tags: disk
tests:
  drivers.disk.usdhc:
    harness_config:
      fixture: fixture_sdhc
    filter: CONFIG_SDHC
    extra_configs:
      - CONFIG_DISK_DRIVER_SDMMC=y
    tags: mcux
    integration_platforms:
      - mimxrt1060_evk
      - mimxrt1050_evk
      - mimxrt1064_evk
  drivers.disk.ram:
    platform_allow: qemu_x86_64
  drivers.disk.nvme:
    extra_configs:
      - CONFIG_NVME=y
    platform_allow: qemu_x86_64
  drivers.disk.simulator.no_explicit_erase:
    extra_args: DTC_OVERLAY_FILE=boards/native_posix_no_explicit_erase.overlay
    extra_configs:
      - CONFIG_DISK_DRIVER_FLASH=y
      - CONFIG_FLASH_SIMULATOR_EXPLICIT_ERASE=n
    platform_allow:
      - native_posix/native/64
      - native_posix
```

## tests/subsys/settings/littlefs/debase64/testcase.yaml
```yaml
# SPDX-License-Identifier: Apache-2.0
# Copyright (c) 2020 Nordic Semiconductor ASA

tests:
  system.settings.littlefs:
    platform_whitelist: native_posix native_posix_64
    tags: settings_fs filesystem
```

## tests/subsys/settings/nffs/debase64/testcase.yaml
```yaml
# SPDX-License-Identifier: Apache-2.0
# Copyright (c) 2020 Nordic Semiconductor ASA

tests:
  system.settings.nffs:
    platform_whitelist: native_posix native_posix_64
    tags: settings_fs filesystem
```
